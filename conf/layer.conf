## conf/layer.conf
```bitbake
# Layer configuration for meta-soc-rpi
# Yocto Project Layer - Raspberry Pi
# Compatible with Yocto scarthgap

BBPATH .= ":${LAYERDIR}"

BBFILES += "${LAYERDIR}/recipes-*/*/*.bb \
            ${LAYERDIR}/recipes-*/*/*.bbappend"

BBFILE_COLLECTIONS += "meta-soc-rpi"
BBFILE_PATTERN_meta-soc-rpi = "^${LAYERDIR}/"
BBFILE_PRIORITY_meta-soc-rpi = "10"

LAYERDEPENDS_meta-soc-rpi = "core"
LAYERDEPENDS_meta-soc-rpi += "raspberrypi"
LAYERDEPENDS_meta-soc-rpi += "openembedded-layer"
LAYERDEPENDS_meta-soc-rpi += "meta-python"

LAYERSERIES_COMPAT_meta-soc-rpi = "kirkstone scarthgap"

# Layer version
LAYERVERSION_meta-soc-rpi = "1"
```
